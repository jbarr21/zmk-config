#include <dt-bindings/zmk/mouse.h>

#define U_MOUSE_MOVE_EXPONENT 1
#define U_MOUSE_MOVE_TIME 400
#define U_MOUSE_MOVE_DELAY 0

#define U_MOUSE_SCROLL_EXPONENT 1
#define U_MOUSE_SCROLL_TIME 400
#define U_MOUSE_SCROLL_DELAY 0

#define U_MOUSE_MOVE_MAX 1500
#define U_MOUSE_SCROLL_MAX 20

#define MS_UP MOVE_Y(-U_MOUSE_MOVE_MAX)
#define MS_DOWN MOVE_Y(U_MOUSE_MOVE_MAX)
#define MS_LEFT MOVE_X(-U_MOUSE_MOVE_MAX)
#define MS_RIGHT MOVE_X(U_MOUSE_MOVE_MAX)
#define WH_UP MOVE_Y(U_MOUSE_SCROLL_MAX)
#define WH_DOWN MOVE_Y(-U_MOUSE_SCROLL_MAX)
#define WH_LEFT MOVE_X(-U_MOUSE_SCROLL_MAX)
#define WH_RIGHT MOVE_X(U_MOUSE_SCROLL_MAX)

&mmv {
  acceleration-exponent = <U_MOUSE_MOVE_EXPONENT>;
  time-to-max-speed-ms = <U_MOUSE_MOVE_TIME>;
  delay-ms = <U_MOUSE_MOVE_DELAY>;
};

&msc {
  acceleration-exponent = <U_MOUSE_SCROLL_EXPONENT>;
  time-to-max-speed-ms = <U_MOUSE_SCROLL_TIME>;
  delay-ms = <U_MOUSE_SCROLL_DELAY>;
};
