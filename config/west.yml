## config/west.yml
```yaml
manifest:
  remotes:
    - name: zmk
      url-base: https://github.com/zmkfirmware
    - name: urob
      url-base: https://github.com/urob
    - name: jbarr21
      url-base: https://github.com/jbarr21
  projects:
    - name: zmk
      remote: zmk
      revision: v0.3
      import: app/west.yml
  self:
    path: config
```
