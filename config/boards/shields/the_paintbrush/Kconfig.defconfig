## config/boards/shields/the_paintbrush/Kconfig.defconfig
```kconfig
if SHIELD_THE_PAINTBRUSH_LEFT || SHIELD_THE_PAINTBRUSH_RIGHT

config ZMK_KEYBOARD_NAME
	default "The Paintbrush"

config I2C
	default n

config SSD1306
	default n

config SSD1306_REVERSE_MODE
	default n

config LV_Z_VDB_SIZE
	default 64

config LV_DPI_DEF
	default 148

config LV_Z_BITS_PER_PIXEL
	default 1

choice LV_COLOR_DEPTH
	default LV_COLOR_DEPTH_1
endchoice

endif
```
