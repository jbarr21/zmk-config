/*
 * Copyright (c) 2020 The ZMK Contributors
 *
 * SPDX-License-Identifier: MIT
 */

#include <behaviors.dtsi>
#include <dt-bindings/zmk/keys.h>
#include <dt-bindings/zmk/bt.h>
#include <dt-bindings/zmk/ext_power.h>
#include <dt-bindings/zmk/mouse.h>
#include <dt-bindings/zmk/outputs.h>
#include "../zmk-nodefree-config/helper.h"

// Layer aliases
#define DEF 0
#define SYM 1
#define NAV 2
#define NUM 3
#define IDE 4
#define FUN 5
#define MOU 6
#define MED 7
#define LCK 8

// Define shortcuts
#define ___      &none
#define VIMAC    LG(LS(LA(LC(F))))
#define EMOJ     LG(LC(SPACE))
#define ALFR     LG(SPACE)
#define CTXS     LA(TAB)
#define HIST_BK  LG(LBKT)
#define HIST_FW  LG(RBKT)
#define TAB_LT   LS(LG(LBKT))
#define TAB_RT   LS(LG(RBKT))
#define APP_WIN  LG(GRAVE)
#define HYPER    LG(LS(LA(LCTRL)))
#define MEH      LS(LA(LCTRL))

// IJ shortcuts
#define CLS_METH LG(F12)
#define FIND_USE LA(F7)
#define RENAME   LS(F6)
#define BRK_PT   LG(F8)
#define DBG_OVER F8
#define DBG_IN   F7
#define DBG_OUT  LS(F8)
#define DBG_RES  LA(LG(R))
#define DBG_EVAL LA(F8)

#include "combos.dtsi"  // must be sourced after layer-shortcuts
#include "mouse.dtsi"
#include "xtr_defaults.h"

/* Homerow mods */

#define TAPPING_TERM_MS 280
#define QUICK_TAP_MS 175
#define GLOBAL_QUICK_TAP_MS 150

#define KEYS_L LT0 LT1 LT2 LT3 LT4 LM0 LM1 LM2 LM3 LM4 LB0 LB1 LB2 LB3 LB4  // left-hand keys
#define KEYS_R RT0 RT1 RT2 RT3 RT4 RM0 RM1 RM2 RM3 RM4 RB0 RB1 RB2 RB3 RB4  // right-hand keys
#define THUMBS LH2 LH1 LH0 RH0 RH1 RH2                                      // thumb keys

ZMK_BEHAVIOR(hml, hold_tap,  // left-hand HRMs
    flavor = "balanced";
    tapping-term-ms = <280>;
    quick-tap-ms = <QUICK_TAP_MS>;
    global-quick-tap-ms = <GLOBAL_QUICK_TAP_MS>;  // requires PR #1387
    bindings = <&kp>, <&kp>;
    hold-trigger-key-positions = <KEYS_R THUMBS>;
    hold-trigger-on-release;                      // requires PR #1423
)

ZMK_BEHAVIOR(hmr, hold_tap,  // right-hand HRMs
    flavor = "balanced";
    tapping-term-ms = <280>;
    quick-tap-ms = <QUICK_TAP_MS>;
    global-quick-tap-ms = <GLOBAL_QUICK_TAP_MS>;  // requires PR #1387
    bindings = <&kp>, <&kp>;
    hold-trigger-key-positions = <KEYS_L THUMBS>;
    hold-trigger-on-release;                      // requires PR #1423
)

&mt {
    flavor = "tap-preferred";
    tapping-term-ms = <220>;
    quick-tap-ms = <220>;
    hold-trigger-key-positions = <0>;
};

&lt {
    flavor = "balanced";
    tapping-term-ms = <200>;
    quick-tap-ms = <QUICK_TAP_MS>;
};

&sk {
    release-after-ms = <5000>;
};

&sl {
    ignore-modifiers;
    release-after-ms = <5000>;
};

&caps_word {
    continue-list = <UNDERSCORE MINUS BSPC DEL N1 N2 N3 N4 N5 N6 N7 N8 N9 N0>;
};

ZMK_BEHAVIOR(ulck, tap_dance,
    tapping-term-ms = <150>;
    bindings = <&none>, <&to DEF>;
)

ZMK_BEHAVIOR(com_dqt, mod_morph,
    bindings = <&kp COMMA>, <&kp DQT>;
    mods = <(MOD_LSFT|MOD_RSFT)>;
)

ZMK_BEHAVIOR(dot_sqt, mod_morph,
    bindings = <&kp DOT>, <&kp SQT>;
    mods = <(MOD_LSFT|MOD_RSFT)>;
)

ZMK_BEHAVIOR(bsp_del, mod_morph,
    bindings = <&kp BSPC>, <&kp DEL>;
    mods = <(MOD_LSFT|MOD_RSFT)>;
)

ZMK_BEHAVIOR(lt2, hold_tap,
    flavor = "balanced";
    tapping-term-ms = <200>;
    quick-tap-ms = <QUICK_TAP_MS>;
    bindings = <&mo>, <&bsp_del>;
)

/* keymap */

ZMK_LAYER_LABELED(layer_default, "DEF",
// ╭───────┬─────────────┬─────────────┬─────────────┬─────────────┬─────────────╮   ╭─────────────┬─────────────┬─────────────┬─────────────┬─────────────┬────────╮
    XTR_LTO  &kp Q         &kp W         &kp F         &kp P         &kp G             &kp J         &kp L         &kp U         &kp Y         &kp SEMI      XTR_RTO  
// ├───────┼─────────────┼─────────────┼─────────────┼─────────────┼─────────────┤   ├─────────────┼─────────────┼─────────────┼─────────────┼─────────────┼────────┤
    XTR_LMO  &hml LCTRL A  &hml LALT R   &hml LSHFT S  &hml LGUI T   &kp D             &kp H         &hmr RGUI N   &hmr RSHFT E  &hmr LALT I   &hmr RCTRL O  XTR_RMO  
// ├───────┼─────────────┼─────────────┼─────────────┼─────────────┼─────────────┤   ├─────────────┼─────────────┼─────────────┼─────────────┼─────────────┼────────┤
    XTR_LBO  &lt MED Z     &kp X         &kp C         &kp V         &kp B             &kp K         &kp M         &com_dqt      &dot_sqt      &lt MED FSLH  XTR_RBO  
// ╰───────┴─────────────┴─────────────┼─────────────┼─────────────┼─────────────┤   ├─────────────┼─────────────┼─────────────┼─────────────┴─────────────┴────────╯
                                         &lt MOU ESC   &lt2 NAV BSPC &lt NUM TAB       &lt IDE RET   &lt SYM SPACE &sk LSHFT
//                                     ╰─────────────┴─────────────┴─────────────╯   ╰─────────────┴─────────────┴─────────────╯
)

ZMK_LAYER_LABELED(layer_symbols, "SYM",
// ╭───────┬─────────────┬─────────────┬─────────────┬─────────────┬─────────────╮   ╭─────────────┬─────────────┬─────────────┬─────────────┬─────────────┬────────╮
    XTR_LTO  &kp EXCL      &kp AT        &kp HASH      &kp DLLR      &kp PRCNT         &kp CARET     &kp AMPS      &kp STAR      &kp DQT       &kp SQT       XTR_RTO  
// ├───────┼─────────────┼─────────────┼─────────────┼─────────────┼─────────────┤   ├─────────────┼─────────────┼─────────────┼─────────────┼─────────────┼────────┤
    XTR_LMO  &kp PLUS      &kp UNDER     &kp EQUAL     &kp MINUS     &kp GRAVE         &kp PIPE      &sk LGUI      &sk LSHFT     &sk LALT      &sk LCTRL     XTR_RMO  
// ├───────┼─────────────┼─────────────┼─────────────┼─────────────┼─────────────┤   ├─────────────┼─────────────┼─────────────┼─────────────┼─────────────┼────────┤
    XTR_LBO  &kp LT        &kp LBKT      &kp LBRC      &kp LPAR      &kp TILDE         &kp BSLH      &kp RPAR      &kp RBRC      &kp RBKT      &kp GT        XTR_RBO  
// ╰───────┴─────────────┴─────────────┼─────────────┼─────────────┼─────────────┤   ├─────────────┼─────────────┼─────────────┼─────────────┴─────────────┴────────╯
                                         ___           ___           ___               &mo MED       ___           ___   
//                                     ╰─────────────┴─────────────┴─────────────╯   ╰─────────────┴─────────────┴─────────────╯
)

ZMK_LAYER_LABELED(layer_nav, "NAV",
// ╭───────┬─────────────┬─────────────┬─────────────┬─────────────┬─────────────╮   ╭─────────────┬─────────────┬─────────────┬─────────────┬─────────────┬────────╮
    XTR_LTO  ___           ___           ___           ___           ___               ___           &kp HIST_BK   &kp TAB_LT    &kp TAB_RT    &kp HIST_FW   XTR_RTO  
// ├───────┼─────────────┼─────────────┼─────────────┼─────────────┼─────────────┤   ├─────────────┼─────────────┼─────────────┼─────────────┼─────────────┼────────┤
    XTR_LMO  &sk LCTRL     &sk LALT      &sk LSHFT     &sk LGUI      ___               &kp APP_WIN   &kp LEFT      &kp DOWN      &kp UP        &kp RIGHT     XTR_RMO  
// ├───────┼─────────────┼─────────────┼─────────────┼─────────────┼─────────────┤   ├─────────────┼─────────────┼─────────────┼─────────────┼─────────────┼────────┤
    XTR_LBO  ___           ___           ___           ___           ___               ___           &kp HOME      &kp PG_DN     &kp PG_UP     &kp END       XTR_RBO  
// ╰───────┴─────────────┴─────────────┼─────────────┼─────────────┼─────────────┤   ├─────────────┼─────────────┼─────────────┼─────────────┴─────────────┴────────╯
                                         ___           ___           ___               ___           ___           ___   
//                                     ╰─────────────┴─────────────┴─────────────╯   ╰─────────────┴─────────────┴─────────────╯
)

ZMK_LAYER_LABELED(layer_num, "NUM",
// ╭───────┬─────────────┬─────────────┬─────────────┬─────────────┬─────────────╮   ╭─────────────┬─────────────┬─────────────┬─────────────┬─────────────┬────────╮
    XTR_LTO  &kp PLUS      &kp FSLH      &kp STAR      &kp MINUS     ___               ___           &kp N7        &kp N8        &kp N9        ___           XTR_RTO  
// ├───────┼─────────────┼─────────────┼─────────────┼─────────────┼─────────────┤   ├─────────────┼─────────────┼─────────────┼─────────────┼─────────────┼────────┤
    XTR_LMO  &sk LCTRL     &sk LALT      &sk LSHFT     &sk LGUI      ___               ___           &kp N4        &kp N5        &kp N6        ___           XTR_RMO  
// ├───────┼─────────────┼─────────────┼─────────────┼─────────────┼─────────────┤   ├─────────────┼─────────────┼─────────────┼─────────────┼─────────────┼────────┤
    XTR_LBO  ___           ___           ___           ___           ___               ___           &kp N1        &kp N2        &kp N3        ___           XTR_RBO  
// ╰───────┴─────────────┴─────────────┼─────────────┼─────────────┼─────────────┤   ├─────────────┼─────────────┼─────────────┼─────────────┴─────────────┴────────╯
                                         ___           ___           ___               &lt FUN DOT   &kp N0        ___   
//                                     ╰─────────────┴─────────────┴─────────────╯   ╰─────────────┴─────────────┴─────────────╯
)

ZMK_LAYER_LABELED(layer_ide, "IDE",
// ╭───────┬─────────────┬─────────────┬─────────────┬─────────────┬─────────────╮   ╭─────────────┬─────────────┬─────────────┬─────────────┬─────────────┬────────╮
    XTR_LTO  ___           ___           ___           ___           ___               ___           &kp A         &kp S         &kp W         &kp D         XTR_RTO  
// ├───────┼─────────────┼─────────────┼─────────────┼─────────────┼─────────────┤   ├─────────────┼─────────────┼─────────────┼─────────────┼─────────────┼────────┤
    XTR_LMO  &sk LCTRL     &kp CLS_METH  &kp FIND_USE  &kp RENAME    &kp BRK_PT        ___           &kp H         &kp J         &kp K         &kp L         XTR_RMO  
// ├───────┼─────────────┼─────────────┼─────────────┼─────────────┼─────────────┤   ├─────────────┼─────────────┼─────────────┼─────────────┼─────────────┼────────┤
    XTR_LBO  &kp DBG_OVER  &kp DBG_IN    &kp DBG_OUT   &kp DBG_RES   &kp DBG_EVAL      ___           ___           ___           ___           ___           XTR_RBO  
// ╰───────┴─────────────┴─────────────┼─────────────┼─────────────┼─────────────┤   ├─────────────┼─────────────┼─────────────┼─────────────┴─────────────┴────────╯
                                         ___           ___           &mo FUN           ___           &mo MED       ___   
//                                     ╰─────────────┴─────────────┴─────────────╯   ╰─────────────┴─────────────┴─────────────╯
)

ZMK_LAYER_LABELED(layer_fun, "FUN",
// ╭───────┬─────────────┬─────────────┬─────────────┬─────────────┬─────────────╮   ╭─────────────┬─────────────┬─────────────┬─────────────┬─────────────┬────────╮
    XTR_LTO  ___           ___           ___           ___           ___               &kp F12       &kp F7        &kp F8        &kp F9        &kp F15       XTR_RTO  
// ├───────┼─────────────┼─────────────┼─────────────┼─────────────┼─────────────┤   ├─────────────┼─────────────┼─────────────┼─────────────┼─────────────┼────────┤
    XTR_LMO  &sk LCTRL     &sk LALT      &sk LSHFT     &sk LGUI      ___               &kp F11       &kp F4        &kp F5        &kp F6        &kp F14       XTR_RMO  
// ├───────┼─────────────┼─────────────┼─────────────┼─────────────┼─────────────┤   ├─────────────┼─────────────┼─────────────┼─────────────┼─────────────┼────────┤
    XTR_LBO  ___           ___           ___           ___           ___               &kp F10       &kp F1        &kp F2        &kp F3        &kp F13       XTR_RBO  
// ╰───────┴─────────────┴─────────────┼─────────────┼─────────────┼─────────────┤   ├─────────────┼─────────────┼─────────────┼─────────────┴─────────────┴────────╯
                                         ___           ___           ___               ___           ___           ___   
//                                     ╰─────────────┴─────────────┴─────────────╯   ╰─────────────┴─────────────┴─────────────╯
)

ZMK_LAYER_LABELED(layer_mouse, "MOU",
// ╭───────┬─────────────┬─────────────┬─────────────┬─────────────┬─────────────╮   ╭─────────────┬─────────────┬─────────────┬─────────────┬─────────────┬────────╮
    XTR_LTO  &bootloader   ___           ___           ___           ___               ___           ___           ___           ___          ___            XTR_RTO  
// ├───────┼─────────────┼─────────────┼─────────────┼─────────────┼─────────────┤   ├─────────────┼─────────────┼─────────────┼─────────────┼─────────────┼────────┤
    XTR_LMO  &sk LCTRL     &sk LALT      &sk LSHFT     &sk LGUI      ___               &kp F16       &mmv MS_LEFT  &mmv MS_DOWN  &mmv MS_UP   &mmv MS_RIGHT  XTR_RMO  
// ├───────┼─────────────┼─────────────┼─────────────┼─────────────┼─────────────┤   ├─────────────┼─────────────┼─────────────┼─────────────┼─────────────┼────────┤
    XTR_LBO  &reset        ___           ___           ___           ___               ___           &mwh WH_LEFT  &mwh WH_DOWN  &mwh WH_UP   &mwh WH_RIGHT  XTR_RBO  
// ╰───────┴─────────────┴─────────────┼─────────────┼─────────────┼─────────────┤   ├─────────────┼─────────────┼─────────────┼─────────────┴─────────────┴────────╯
                                         ___           ___           ___               ___           &mkp MB1      &mkp MB2
//                                     ╰─────────────┴─────────────┴─────────────╯   ╰─────────────┴─────────────┴─────────────╯
)

ZMK_LAYER_LABELED(layer_media, "MED",
// ╭───────┬─────────────┬─────────────┬─────────────┬─────────────┬─────────────╮   ╭─────────────┬─────────────┬─────────────┬─────────────┬─────────────┬────────╮
    XTR_LTO  ___           ___           ___           ___           ___               ___           ___           ___           ___           &bootloader   XTR_RTO  
// ├───────┼─────────────┼─────────────┼─────────────┼─────────────┼─────────────┤   ├─────────────┼─────────────┼─────────────┼─────────────┼─────────────┼────────┤
    XTR_LMO  &kp C_PREV    &kp C_VOL_DN  &kp C_VOL_UP  &kp C_NEXT    &ext_power EP_TOG ___           &sk LGUI      &sk LSHFT     &sk LALT      &sk LCTRL     XTR_RMO  
// ├───────┼─────────────┼─────────────┼─────────────┼─────────────┼─────────────┤   ├─────────────┼─────────────┼─────────────┼─────────────┼─────────────┼────────┤
    XTR_LBO  &bt BT_CLR    &bt BT_SEL 2  &bt BT_SEL 1  &bt BT_SEL 0  &out OUT_TOG      ___           ___           ___           ___           &reset        XTR_RBO  
// ╰───────┴─────────────┴─────────────┼─────────────┼─────────────┼─────────────┤   ├─────────────┼─────────────┼─────────────┼─────────────┴─────────────┴────────╯
                                         ___           &kp C_PP      &kp C_MUTE        ___           ___           ___   
//                                     ╰─────────────┴─────────────┴─────────────╯   ╰─────────────┴─────────────┴─────────────╯
)

ZMK_LAYER_LABELED(layer_lockout, "LCK",
// ╭───────┬─────────────┬─────────────┬─────────────┬─────────────┬─────────────╮   ╭─────────────┬─────────────┬─────────────┬─────────────┬─────────────┬────────╮
    XTR_LTO  ___           ___           ___           ___           ___               ___           ___           &ulck         ___           ___           XTR_RTO  
// ├───────┼─────────────┼─────────────┼─────────────┼─────────────┼─────────────┤   ├─────────────┼─────────────┼─────────────┼─────────────┼─────────────┼────────┤
    XTR_LMO  ___           ___           ___           ___           ___               ___           ___           ___           ___           ___           XTR_RMO  
// ├───────┼─────────────┼─────────────┼─────────────┼─────────────┼─────────────┤   ├─────────────┼─────────────┼─────────────┼─────────────┼─────────────┼────────┤
    XTR_LBO  ___           ___           ___           ___           ___               ___           ___           ___           ___           ___           XTR_RBO  
// ╰───────┴─────────────┴─────────────┼─────────────┼─────────────┼─────────────┤   ├─────────────┼─────────────┼─────────────┼─────────────┴─────────────┴────────╯
                                         ___           ___           ___               ___           ___           ___   
//                                     ╰─────────────┴─────────────┴─────────────╯   ╰─────────────┴─────────────┴─────────────╯
)
