#include "../zmk-nodefree-config/keypos_def/keypos_42keys.h"
#include "extra_keys_thumbs_three.h"

#define XTR_LTO  &none
#define XTR_LMO  &kp ESC
#define XTR_LBO  &none
#define XTR_RTO  &kp BSLH
#define XTR_RMO  &kp SQT
#define XTR_RBO  &none

#include "3x5.dtsi"

/ {
  chosen {
    zmk,matrix_transform = &default_transform;
  };
};

